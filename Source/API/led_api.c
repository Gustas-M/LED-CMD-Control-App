/**********************************************************************************************************************
 * Includes
 *********************************************************************************************************************/
#include "led_api.h"
#include "gpio_driver.h"
/**********************************************************************************************************************
 * Private definitions and macros
 *********************************************************************************************************************/
#define SET_STATE 1
#define RESET_STATE 0
/**********************************************************************************************************************
 * Private typedef
 *********************************************************************************************************************/
 
/**********************************************************************************************************************
 * Private constants
 *********************************************************************************************************************/
const static sLedApiParams_t g_static_led_params[eLedApi_Last] = {
    [eLedApi_GpsFix] = {
        .led_pin = eGpioPin_LedGpsFix,
        .invertion = true
    },
    [eLedApi_Stat] = {
        .led_pin = eGpioPin_LedStat,
        .invertion = false
    }
};
/**********************************************************************************************************************
 * Private variables
 *********************************************************************************************************************/
 
/**********************************************************************************************************************
 * Exported variables and references
 *********************************************************************************************************************/

/**********************************************************************************************************************
 * Prototypes of private functions
 *********************************************************************************************************************/
 
/**********************************************************************************************************************
 * Definitions of private functions
 *********************************************************************************************************************/
 
/**********************************************************************************************************************
 * Definitions of exported functions
 *********************************************************************************************************************/
bool LED_API_Set (eLedApi_t pin) {
    if ((pin < eLedApi_First) || (pin > eLedApi_Last)) {
        return false;
    }

    return GPIO_Driver_WritePin(g_static_led_params[pin].led_pin, !g_static_led_params[pin].invertion);
}

bool LED_API_Reset (eLedApi_t pin) {
    if ((pin < eLedApi_First) || (pin > eLedApi_Last)) {
        return false;
    }

    return GPIO_Driver_WritePin(g_static_led_params[pin].led_pin, g_static_led_params[pin].invertion);
}

bool LED_API_Write (eLedApi_t pin, bool state) {
    if ((pin < eLedApi_First) || (pin > eLedApi_Last)) {
        return false;
    }

    return GPIO_Driver_WritePin(g_static_led_params[pin].led_pin, state ^= g_static_led_params[pin].invertion);
}

bool LED_API_Toggle (eLedApi_t pin) {
    if ((pin < eLedApi_First) || (pin > eLedApi_Last)) {
        return false;
    }

    return GPIO_Driver_TogglePin(g_static_led_params[pin].led_pin);
}
